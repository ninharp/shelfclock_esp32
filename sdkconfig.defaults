## sdkconfig.defaults
```kconfig
CONFIG_IDF_TARGET="esp32c3"
CONFIG_ESPTOOLPY_FLASHSIZE_4MB=y
CONFIG_PARTITION_TABLE_CUSTOM=y
CONFIG_PARTITION_TABLE_CUSTOM_FILENAME="partitions.csv"
CONFIG_ESP_MAIN_TASK_STACK_SIZE=8192
CONFIG_SPIFFS_MAX_PARTITIONS=1
CONFIG_BT_ENABLED=n
CONFIG_MDNS_ENABLED=y
CONFIG_LWIP_LOCAL_HOSTNAME="shelfclock"
CONFIG_ADC_CALI_LINE_FITTING_EFUSE_VREF_ENABLE=y
CONFIG_ESP_TASK_WDT_TIMEOUT_S=10
CONFIG_FREERTOS_HZ=1000
```
